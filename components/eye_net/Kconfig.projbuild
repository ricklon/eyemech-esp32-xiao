## components/eye_net/Kconfig.projbuild
```kconfig
menu "eyemech networking"

config EYE_NET_STA_SSID
    string "Seed station SSID"
    default ""
    help
        Written into profile 1 the first time the device boots with empty NVS.
        After that NVS wins and this is ignored, so changing a network does not
        need a reflash. Keep real credentials in sdkconfig, which is gitignored
        — never in sdkconfig.defaults, which is checked in.

config EYE_NET_STA_PASSWORD
    string "Seed station password"
    default ""

config EYE_NET_AP_SSID
    string "Recovery access-point SSID"
    default "eyemech-setup"
    help
        This access point is up in every station state and is the way back in
        when no station profile works.

config EYE_NET_AP_PASSWORD
    string "Recovery access-point password"
    default "eyemech123"
    help
        At least eight characters for WPA2; anything shorter creates an OPEN
        access point, which lets anyone on it drive the servos.

config EYE_NET_HOSTNAME
    string "Hostname"
    default "eyemech"
    help
        Used for both the DHCP hostname and the mDNS name, so the board answers
        to <hostname>.local on the station network and on the recovery access
        point. tools/eyectl.py defaults to matching this.

endmenu
```

## components/eye_web/Kconfig.projbuild
```kconfig
menu "eyemech web"

config EYE_WEB_EXTRA_ORIGINS
    string "Extra origins allowed to stream poses"
    default "http://localhost:8080,http://127.0.0.1:8080"
    help
        Browser origins, besides pages served by the board itself, that may open
        /ws/pose. Comma-separated, each an exact scheme://host:port, compared
        without regard to case. The default is the eye-tracking dashboard served
        locally by `just web`, so it can stream follow poses straight to the
        board. A browser cannot forge its Origin, so these admit only pages
        served from the operator's own machine on that port. Leave empty to
        accept same-origin pages only. Non-browser senders send no Origin and
        are unaffected.

endmenu
```
